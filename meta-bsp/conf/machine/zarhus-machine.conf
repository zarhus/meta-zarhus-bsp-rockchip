## meta-bsp/conf/machine/zarhus-machine.conf
```bitbake
require conf/machine/radxa-cm3.conf

# meta-rockchips supplies OP-TEE and ATF via rkbin package as a prebuilt
# binaries. This should be changed to self built binaries using meta-arm layer.
PREFERRED_PROVIDER:trusted-firmware-a = "rockchip-rkbin"
PREFERRED_PROVIDER:optee-os = "rockchip-rkbin"
```

## meta-zarhus-bsp/conf/layer.conf
```bitbake
# We have a conf and classes directory, add to BBPATH
BBPATH .= ":${LAYERDIR}"

# We have recipes-* directories, add to BBFILES
BBFILES += "${LAYERDIR}/recipes-*/*/*.bb ${LAYERDIR}/recipes-*/*/*.bbappend"

BBFILE_COLLECTIONS += "zarhus-bsp"
BBFILE_PATTERN_zarhus-bsp = "^${LAYERDIR}/"
BBFILE_PRIORITY_zarhus-bsp = "1"

# This should only be incremented on significant changes that will
# cause compatibility issues with other layers
LAYERVERSION_zarhus-bsp = "1"

LAYERDEPENDS_zarhus-bsp = " \
    core \
    openembedded-layer \
    "

LAYERSERIES_COMPAT_zarhus-bsp = "master master"
```
